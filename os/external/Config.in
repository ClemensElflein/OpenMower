## os/external/Config.in
```kconfig
source "$BR2_EXTERNAL_OPENMOWER_PATH/package/improv-ble/Config.in"
source "$BR2_EXTERNAL_OPENMOWER_PATH/package/improv-serial/Config.in"
source "$BR2_EXTERNAL_OPENMOWER_PATH/package/openmower-ros/Config.in"
source "$BR2_EXTERNAL_OPENMOWER_PATH/package/openmower-cli/Config.in"
source "$BR2_EXTERNAL_OPENMOWER_PATH/package/vcgencmd/Config.in"
```

## os/external/configs/openmower_cm4_defconfig
```kconfig
BR2_aarch64=y
BR2_cortex_a72=y
BR2_ARM_FPU_VFPV4=y
BR2_TOOLCHAIN_EXTERNAL=y
BR2_TOOLCHAIN_EXTERNAL_BOOTLIN=y
BR2_TOOLCHAIN_EXTERNAL_BOOTLIN_AARCH64_GLIBC_STABLE=y
BR2_CCACHE=y
BR2_CCACHE_DIR="/work/os/.cache/ccache"
BR2_GLOBAL_PATCH_DIR="board/raspberrypi/patches"
BR2_DOWNLOAD_FORCE_CHECK_HASHES=y
BR2_TARGET_GENERIC_HOSTNAME="openmower"
BR2_TARGET_GENERIC_ISSUE="OpenMower OS"
BR2_INIT_SYSTEMD=y
BR2_ROOTFS_DEVICE_TABLE="system/device_table.txt $(BR2_EXTERNAL_OPENMOWER_PATH)/board/openmower-cm4/device_table.txt"
BR2_TARGET_GENERIC_ROOT_PASSWD="openmower"
BR2_SYSTEM_DEFAULT_PATH="/usr/sbin:/usr/bin:/sbin:/bin"
BR2_ROOTFS_OVERLAY="$(BR2_EXTERNAL_OPENMOWER_PATH)/board/openmower-cm4/rootfs-overlay"
BR2_ROOTFS_POST_BUILD_SCRIPT="$(BR2_EXTERNAL_OPENMOWER_PATH)/board/openmower-cm4/post-build.sh"
BR2_ROOTFS_POST_FAKEROOT_SCRIPT="$(BR2_EXTERNAL_OPENMOWER_PATH)/board/openmower-cm4/post-fakeroot.sh"
BR2_ROOTFS_POST_IMAGE_SCRIPT="$(BR2_EXTERNAL_OPENMOWER_PATH)/board/openmower-cm4/post-image.sh"
BR2_LINUX_KERNEL=y
BR2_LINUX_KERNEL_CUSTOM_TARBALL=y
BR2_LINUX_KERNEL_CUSTOM_TARBALL_LOCATION="$(call github,raspberrypi,linux,21b410140c47ffab5668399f6f143c7d7b935c8b)/linux-21b410140c47ffab5668399f6f143c7d7b935c8b.tar.gz"
BR2_LINUX_KERNEL_DEFCONFIG="bcm2711"
BR2_LINUX_KERNEL_CONFIG_FRAGMENT_FILES="$(BR2_EXTERNAL_OPENMOWER_PATH)/board/openmower-cm4/kernel-fragment.config"
BR2_LINUX_KERNEL_DTS_SUPPORT=y
BR2_LINUX_KERNEL_INTREE_DTS_NAME="broadcom/bcm2711-rpi-4-b broadcom/bcm2711-rpi-cm4"
BR2_LINUX_KERNEL_NEEDS_HOST_OPENSSL=y
BR2_PACKAGE_E2FSPROGS=y
BR2_PACKAGE_BRCMFMAC_SDIO_FIRMWARE_RPI=y
BR2_PACKAGE_BRCMFMAC_SDIO_FIRMWARE_RPI_BT=y
BR2_PACKAGE_BRCMFMAC_SDIO_FIRMWARE_RPI_WIFI=y
BR2_PACKAGE_RPI_FIRMWARE=y
BR2_PACKAGE_RPI_FIRMWARE_VARIANT_PI4=y
BR2_PACKAGE_RPI_FIRMWARE_CONFIG_FILE="$(BR2_EXTERNAL_OPENMOWER_PATH)/board/openmower-cm4/rootfs-overlay/etc/openmower/config.txt.default"
BR2_PACKAGE_OPENOCD=y
BR2_PACKAGE_OPENOCD_BCM2835=y
BR2_PACKAGE_PYTHON3=y
BR2_PACKAGE_PYTHON3_SSL=y
BR2_PACKAGE_PYTHON3_ZLIB=y
BR2_PACKAGE_CA_CERTIFICATES=y
BR2_PACKAGE_LIBCURL=y
BR2_PACKAGE_LIBCURL_CURL=y
BR2_PACKAGE_BLUEZ5_UTILS=y
BR2_PACKAGE_BLUEZ5_UTILS_CLIENT=y
BR2_PACKAGE_BLUEZ5_UTILS_TOOLS=y
BR2_PACKAGE_DNSMASQ=y
# BR2_PACKAGE_DNSMASQ_TFTP is not set
BR2_PACKAGE_DROPBEAR=y
BR2_PACKAGE_IW=y
BR2_PACKAGE_SOCAT=y
BR2_PACKAGE_TCPDUMP=y
BR2_PACKAGE_WIRELESS_REGDB=y
BR2_PACKAGE_WPA_SUPPLICANT=y
BR2_PACKAGE_WPA_SUPPLICANT_WPA3=y
BR2_PACKAGE_WPA_SUPPLICANT_CLI=y
BR2_PACKAGE_WPA_SUPPLICANT_PASSPHRASE=y
BR2_PACKAGE_BASH=y
BR2_PACKAGE_DOCKER_CLI=y
BR2_PACKAGE_DOCKER_COMPOSE=y
BR2_PACKAGE_DOCKER_ENGINE=y
BR2_PACKAGE_HTOP=y
BR2_PACKAGE_RAUC=y
BR2_PACKAGE_RAUC_DBUS=y
BR2_PACKAGE_SYSTEMD_NSPAWN=y
BR2_PACKAGE_MC=y
BR2_PACKAGE_NANO=y
BR2_TARGET_ROOTFS_SQUASHFS=y
BR2_TARGET_ROOTFS_SQUASHFS4_ZSTD=y
# BR2_TARGET_ROOTFS_TAR is not set
BR2_PACKAGE_HOST_DOSFSTOOLS=y
BR2_PACKAGE_HOST_E2FSPROGS=y
BR2_PACKAGE_HOST_GENIMAGE=y
BR2_PACKAGE_HOST_GO_BIN=y
BR2_PACKAGE_HOST_KMOD_XZ=y
BR2_PACKAGE_HOST_MTOOLS=y
BR2_PACKAGE_HOST_RAUC=y
BR2_PACKAGE_IMPROV_BLE=y
BR2_PACKAGE_IMPROV_SERIAL=y
BR2_PACKAGE_OPENMOWER_ROS=y
BR2_PACKAGE_OPENMOWER_CLI=y
```

## os/external/package/improv-ble/Config.in
```kconfig
config BR2_PACKAGE_IMPROV_BLE
	bool "improv-ble"
	depends on BR2_PACKAGE_PYTHON3
	select BR2_PACKAGE_PYTHON_DBUS_FAST
	help
	  Wifi provisioning daemon implementing the Improv Wi-Fi BLE
	  protocol (https://www.improv-wifi.com) as a BlueZ GATT server.
	  Runs while the device is unprovisioned; writes the received
	  credentials to /data/wifi and hands over to wpa_supplicant.
```

## os/external/package/improv-serial/Config.in
```kconfig
config BR2_PACKAGE_IMPROV_SERIAL
	bool "improv-serial"
	depends on BR2_PACKAGE_PYTHON3
	select BR2_PACKAGE_PYTHON_SERIAL
	help
	  Wifi provisioning daemon implementing the Improv Wi-Fi Serial
	  protocol (https://www.improv-wifi.com) on /dev/ttyGS1 (the USB0
	  composite gadget's second CDC ACM function). Writes received
	  credentials to /data/wifi and hands over to wpa_supplicant. Unlike
	  improv-ble, keeps running permanently so credentials can be
	  replaced at any time, not just during initial setup.
```

## os/external/package/openmower-cli/Config.in
```kconfig
config BR2_PACKAGE_OPENMOWER_CLI
	bool "openmower-cli"
	depends on BR2_PACKAGE_PYTHON3
	help
	  OpenMower CLI (github.com/ClemensElflein/openmower-cli): firmware/
	  openocd/serial-bridge helpers for the xCore, plus Docker Compose
	  stack management. Unmodified upstream zipapp release, needs only a
	  python3 interpreter on PATH to run.

	  Its Compose-stack integration (default paths, default service) is
	  being aligned with this repo's layout (open_mower_ros runs via
	  systemd-nspawn, not docker-compose) in a follow-up -- not yet wired
	  up here beyond installing the binary.
```

## os/external/package/openmower-ros/Config.in
```kconfig
config BR2_PACKAGE_OPENMOWER_ROS
	bool "openmower-ros"
	help
	  Vendored ROS Noetic + open_mower_ros install tree, fetched by
	  build.sh (either pulled prebuilt from GHCR, or cross-built locally
	  via docker buildx --platform linux/arm64 from
	  open_mower_ros/docker/Dockerfile) into .cache/openmower-rootfs.
	  Buildroot never touches apt/dpkg itself -- this package just copies
	  that prebuilt tree wholesale into the target rootfs under
	  /opt/openmower-root.

	  At runtime, openmower.service boots that tree via systemd-nspawn
	  (BR2_PACKAGE_SYSTEMD_NSPAWN) -- a lightweight container runtime
	  built into systemd, not docker/podman.
```

## os/external/package/vcgencmd/Config.in
```kconfig
config BR2_PACKAGE_VCGENCMD
	bool "vcgencmd"
	help
	  Raspberry Pi VideoCore userspace tools, built from
	  github.com/raspberrypi/userland: vcgencmd (SoC temperature,
	  voltages, clocks, throttling status), plus vcmailbox, dtoverlay
	  and dtmerge. Buildroot dropped its own rpi-userland package
	  upstream (Config.in.legacy: "ancient and deprecated") -- this
	  vendors just the small subset actually useful here directly,
	  pinned to a single commit. Not named rpi-userland/RPI_USERLAND
	  to avoid colliding with that removed package's reserved legacy
	  Kconfig symbol.

	  Deliberately not the GL/EGL/OpenMAX/MMAL/raspicam side of this
	  tree -- upstream's own CMakeLists already skips all of that on
	  aarch64 (ARM64 build), which is all this image ever targets, so
	  there's nothing to trim by hand here.

	  https://github.com/raspberrypi/userland
```
